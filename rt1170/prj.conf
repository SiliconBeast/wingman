## CMakeLists.txt
```
cmake_minimum_required(VERSION 3.20.0)
find_package(Zephyr REQUIRED HINTS $ENV{ZEPHYR_BASE})
project(wingman_rt1170)

target_include_directories(app PRIVATE ${CMAKE_CURRENT_SOURCE_DIR}/../protocol src)
target_sources(app PRIVATE
  src/main.c
  src/wm_logic.c
  src/wm_stats.c
  src/imu.c
  src/shell.c
)
```

## prj.conf
```kconfig
# --- networking: static 192.168.10.2 on the 100 Mbit port (ENET, KSZ8081) ---
CONFIG_NETWORKING=y
CONFIG_NET_IPV4=y
CONFIG_NET_IPV6=n
CONFIG_NET_UDP=y
CONFIG_NET_TCP=n
CONFIG_NET_SOCKETS=y
CONFIG_NET_CONFIG_SETTINGS=y
CONFIG_NET_CONFIG_MY_IPV4_ADDR="192.168.10.2"
CONFIG_NET_CONFIG_MY_IPV4_NETMASK="255.255.255.0"
# don't stall boot waiting for a cable; the address is applied either way
CONFIG_NET_CONFIG_INIT_TIMEOUT=0
CONFIG_NET_SHELL=y
CONFIG_NET_MAX_CONTEXTS=6
CONFIG_NET_PKT_RX_COUNT=32
CONFIG_NET_BUF_RX_COUNT=64

# --- shell / logging ---
CONFIG_SHELL=y
CONFIG_LOG=y
CONFIG_LOG_MODE_DEFERRED=y
CONFIG_KERNEL_SHELL=y
CONFIG_THREAD_NAME=y
CONFIG_THREAD_MONITOR=y
CONFIG_THREAD_RUNTIME_STATS=y

# --- drivers ---
CONFIG_GPIO=y
CONFIG_CRC=y
CONFIG_WATCHDOG=y
CONFIG_HWINFO=y
CONFIG_I2C=y
CONFIG_SENSOR=y

# --- instrumentation ---
CONFIG_TIMING_FUNCTIONS=y
CONFIG_FPU=y
# decide, imu and shell threads all use floating point: save FP context on switch
CONFIG_FPU_SHARING=y

# --- stacks ---
CONFIG_MAIN_STACK_SIZE=4096
CONFIG_SHELL_STACK_SIZE=4096
CONFIG_SYSTEM_WORKQUEUE_STACK_SIZE=2048

# --- PHYTEC manifest injects demo modules into every app; Wingman owns the
#     watchdog, LEDs and button itself, so switch them all off ---
CONFIG_APP_WATCHDOG=n
CONFIG_APP_HEARTBEAT=n
CONFIG_APP_BUTTON=n
CONFIG_APP_AUDIO_SELCALL=n
CONFIG_APP_DAC_SAWTOOTH=n
CONFIG_APP_LED_ROLLOVER=n
CONFIG_APP_LVGL_RANDOM_NUMBER=n
CONFIG_APP_LVGL_TESTCARD=n
CONFIG_APP_LVGL_WIDGETS=n
CONFIG_APP_UPTIME_COUNTER=n
CONFIG_APP_USB_DEVICE=n
```

## boards/native_sim_native_64.conf
```kconfig
# Desktop simulation of the supervisor (host test only, not the judged target).
# Zephyr sockets map to Linux sockets: the "RT1170" listens on the host's :5005.
CONFIG_ETH_NATIVE_POSIX=n
CONFIG_NET_DRIVERS=y
CONFIG_NET_SOCKETS_OFFLOAD=y
CONFIG_NET_NATIVE_OFFLOADED_SOCKETS=y
CONFIG_NET_CONFIG_SETTINGS=n
CONFIG_HEAP_MEM_POOL_SIZE=4096
CONFIG_NATIVE_SIM_SLOWDOWN_TO_REAL_TIME=y
# no hardware watchdog / IMU / crypto HAL on the host
CONFIG_WATCHDOG=n
CONFIG_SENSOR=n
CONFIG_I2C=n
```

## boards/phyboard_atlas_mimxrt1176_cm7.overlay
```dts
/*
 * Logic-analyzer probes on the 60-pin expansion header.
 *   rx-probe    pin 11 (GPIO_AD_34): high from packet arrival until outputs are written
 *   alert-probe pin 33 (GPIO_SNVS_00): toggles on every output write
 * Pins 27/29 are the IMU interrupt lines - don't use them.
 * Ground: any GND pin on the same header.
 */
/ {
	zephyr,user {
		rx-probe-gpios = <&expansion_header 11 GPIO_ACTIVE_HIGH>;
		alert-probe-gpios = <&expansion_header 33 GPIO_ACTIVE_HIGH>;
	};
};

/* Disabled: unused by this app. Was tested as a hypothesis for why the
 * ICM40627 on the same LPI2C5 bus fails its first register write at boot
 * ("Could not initialize sensor") - ruled out, identical failure with the
 * codec disabled (see CLAUDE.md P7 status). Left disabled since it's
 * genuinely unused, not because it fixed anything. */
&audio_codec {
	status = "disabled";
};

/* ROOT CAUSE FOUND: our BSP branch (v4.1.0-phy2) ships the ICM40627 at the
 * wrong I2C address, 0x6b, which is why every register write failed at
 * boot ("Could not initialize sensor"). PHYTEC fixed this upstream in
 * commit aa26522 (v4.4.0-phy branch, merged 2026-07-23):
 * icm40627@6b -> icm40627@69, reg = <0x6b> -> <0x69>. Rather than upgrade
 * the whole BSP manifest this close to the deadline, override just the
 * address here. */
&icm40627 {
	reg = <0x69>;
};
```

## src/main.c
```c
/*
 * Wingman RT1170 safety supervisor.
 *
 *   net_rx  (prio 3)  recvfrom :5005 -> stamp arrival -> parse/CRC -> ev_q
 *   decide  (prio 2)  ev_q -> wm_sup state machine -> LEDs/probes -> stats -> status_q
 *                     feeds the hardware watchdog every loop
 *   hb timer (10 ms)  no valid frame for heartbeat_timeout_ms -> EV_HB_LOST
 *   status_tx(prio 5) status_q -> sendto <last sender>:5006
 *   led timer (62 ms) blink patterns
 *   imu     (prio 6)  see imu.c
 *
 * The decide thread is the only writer of g_sup's state; the shell and IMU
 * threads touch it under g_lock.
 */
#include <zephyr/kernel.h>
#include <zephyr/drivers/gpio.h>
#include <zephyr/drivers/watchdog.h>
#include <zephyr/logging/log.h>
#include <zephyr/net/socket.h>
#include <zephyr/sys/atomic.h>

#if defined(CONFIG_SOC_SERIES_IMXRT11XX)
#include <fsl_soc_src.h>
#endif

#include "wingman_proto.h"
#include "wm_app.h"

LOG_MODULE_REGISTER(wingman, LOG_LEVEL_INF);

#define PRIO_DECIDE    2
#define PRIO_NET_RX    3
#define PRIO_STATUS_TX 5

/* i.MX WDOG1 counts in 0.5 s steps; 500 ms is the shortest timeout it supports. */
#define WM_WDT_TIMEOUT_MS   500
#define WM_DECIDE_POLL_MS   20
#define WM_KEEPALIVE_MS     100
#define WM_DEFAULT_PEER_IP  "192.168.10.1"

struct k_spinlock g_lock;
struct wm_sup g_sup;
struct wm_measurements g_meas;
volatile bool g_hang_requested;

enum ev_kind { EV_FRAME, EV_BAD, EV_HB_LOST };

struct wm_event {
	uint8_t kind;
	uint8_t bad; /* enum wm_parse_result for EV_BAD */
	uint32_t t_arrival_cyc;
	wm_perception_t frame;
};

K_MSGQ_DEFINE(ev_q, sizeof(struct wm_event), 16, 4);
K_MSGQ_DEFINE(status_q, sizeof(wm_status_t), 8, 4);

/* ---------------------------------------------------------------- outputs */

static const struct gpio_dt_spec led_red = GPIO_DT_SPEC_GET_OR(DT_ALIAS(led3), gpios, {0});
static const struct gpio_dt_spec led_green = GPIO_DT_SPEC_GET_OR(DT_ALIAS(led4), gpios, {0});
static const struct gpio_dt_spec som_red = GPIO_DT_SPEC_GET_OR(DT_ALIAS(led1), gpios, {0});
static const struct gpio_dt_spec som_green = GPIO_DT_SPEC_GET_OR(DT_ALIAS(led0), gpios, {0});

/* Logic-analyzer probes on the 60-pin expansion header, defined in app.overlay. */
#define ZEPHYR_USER DT_PATH(zephyr_user)
static const struct gpio_dt_spec probe_rx = GPIO_DT_SPEC_GET_OR(ZEPHYR_USER, rx_probe_gpios, {0});
static const struct gpio_dt_spec probe_alert =
	GPIO_DT_SPEC_GET_OR(ZEPHYR_USER, alert_probe_gpios, {0});

static const struct gpio_dt_spec *const all_pins[] = {&led_red, &led_green, &som_red,
						      &som_green, &probe_rx, &probe_alert};

static void pin_set(const struct gpio_dt_spec *p, int v)
{
	if (p->port) {
		gpio_pin_set_dt(p, v);
	}
}

static void outputs_init(void)
{
	for (size_t i = 0; i < ARRAY_SIZE(all_pins); i++) {
		const struct gpio_dt_spec *p = all_pins[i];

		if (!p->port) {
			continue;
		}
		if (!gpio_is_ready_dt(p) || gpio_pin_configure_dt(p, GPIO_OUTPUT_INACTIVE) != 0) {
			LOG_WRN("output pin %u on %s unavailable", p->pin, p->port->name);
		}
	}
}

static atomic_t led_state = ATOMIC_INIT(WM_BOOT);
static atomic_t led_tick;

/* tick advances every 62.5 ms: bit0 -> 8 Hz blink, bit3 -> 1 Hz blink */
static void leds_write(enum wm_state st, uint32_t tick)
{
	int fast = !(tick & 1u);
	int slow = !(tick & 8u);
	int r = 0, g = 0;

	switch (st) {
	case WM_WAIT_LINK:
		g = slow;
		break;
	case WM_NOMINAL:
		g = 1;
		break;
	case WM_CAUTION: /* amber = red + green */
		r = 1;
		g = 1;
		break;
	case WM_WARNING:
		r = fast;
		break;
	case WM_FAILSAFE:
		r = 1;
		break;
	default:
		break;
	}
	pin_set(&led_red, r);
	pin_set(&som_red, r);
	pin_set(&led_green, g);
	pin_set(&som_green, g);
}

static void led_timer_fn(struct k_timer *t)
{
	ARG_UNUSED(t);
	leds_write((enum wm_state)atomic_get(&led_state), (uint32_t)atomic_inc(&led_tick) + 1);
}
K_TIMER_DEFINE(led_timer, led_timer_fn, NULL);

/* Called by decide on every accepted decision. Writing the LEDs here (not only
 * from the blink timer) makes "outputs written" a real GPIO write.
 */
static void outputs_apply(enum wm_state st, bool changed)
{
	if (changed) {
		atomic_set(&led_state, st);
		atomic_set(&led_tick, 0);
		leds_write(st, 0);
	}
	if (probe_alert.port) {
		gpio_pin_toggle_dt(&probe_alert);
	}
}

/* ---------------------------------------------------------------- watchdog */

static const struct device *const wdt = DEVICE_DT_GET_OR_NULL(DT_ALIAS(watchdog0));
static int wdt_chan = -1;

static void watchdog_start(void)
{
	if (!wdt || !device_is_ready(wdt)) {
		LOG_ERR("watchdog not available");
		return;
	}
	struct wdt_timeout_cfg cfg = {
		.window = {.min = 0, .max = WM_WDT_TIMEOUT_MS},
		.callback = NULL,
		.flags = WDT_FLAG_RESET_SOC,
	};

	wdt_chan = wdt_install_timeout(wdt, &cfg);
	if (wdt_chan < 0) {
		LOG_ERR("wdt_install_timeout: %d", wdt_chan);
		return;
	}
	int err = wdt_setup(wdt, WDT_OPT_PAUSE_HALTED_BY_DBG);

	if (err) {
		LOG_ERR("wdt_setup: %d", err);
		wdt_chan = -1;
		return;
	}
	LOG_INF("watchdog armed, %d ms", WM_WDT_TIMEOUT_MS);
}

static inline void watchdog_feed(void)
{
	if (wdt_chan >= 0) {
		wdt_feed(wdt, wdt_chan);
	}
}

static bool last_reset_was_watchdog(void)
{
#if defined(CONFIG_SOC_SERIES_IMXRT11XX)
	uint32_t f = SRC_GetResetStatusFlags(SRC);
	const uint32_t wdog = kSRC_M7CoreWdogResetFlag | kSRC_M7CoreWdog3ResetFlag |
			      kSRC_M7CoreWdog4ResetFlag;

	LOG_INF("SRC SRSR = 0x%08x", f);
	SRC_ClearGlobalSystemResetStatus(SRC, f);
	return (f & wdog) != 0;
#else
	return false;
#endif
}

/* ---------------------------------------------------------------- heartbeat */

static atomic_t hb_armed;
static atomic_t last_valid_ms;

static void hb_timer_fn(struct k_timer *t)
{
	ARG_UNUSED(t);
	if (!atomic_get(&hb_armed)) {
		return;
	}
	uint32_t age = k_uptime_get_32() - (uint32_t)atomic_get(&last_valid_ms);

	if (age > g_sup.th.heartbeat_timeout_ms) {
		struct wm_event ev = {.kind = EV_HB_LOST};

		/* Only disarm once the event is queued, so a full queue retries next tick. */
		if (k_msgq_put(&ev_q, &ev, K_NO_WAIT) == 0) {
			atomic_clear(&hb_armed);
		}
	}
}
K_TIMER_DEFINE(hb_timer, hb_timer_fn, NULL);

/* ---------------------------------------------------------------- network */

static struct k_spinlock peer_lock;
static struct sockaddr_in peer;

static void net_rx_fn(void *a, void *b, void *c)
{
	ARG_UNUSED(a);
	ARG_UNUSED(b);
	ARG_UNUSED(c);

	static uint8_t buf[256];
	static struct wm_event ev;
	int s = zsock_socket(AF_INET, SOCK_DGRAM, IPPROTO_UDP);

	if (s < 0) {
		LOG_ERR("socket: %d", errno);
		return;
	}
	struct sockaddr_in local = {
		.sin_family = AF_INET,
		.sin_port = htons(WM_PORT_PERCEPTION),
		.sin_addr = {.s_addr = htonl(INADDR_ANY)},
	};

	if (zsock_bind(s, (struct sockaddr *)&local, sizeof(local)) < 0) {
		LOG_ERR("bind :%d: %d", WM_PORT_PERCEPTION, errno);
		return;
	}
	LOG_INF("listening on udp :%d", WM_PORT_PERCEPTION);

	for (;;) {
		struct sockaddr_in src;
		socklen_t slen = sizeof(src);
		ssize_t n = zsock_recvfrom(s, buf, sizeof(buf), 0, (struct sockaddr *)&src, &slen);
		uint32_t t = k_cycle_get_32(); /* first thing */

		if (n < 0) {
			continue;
		}
		pin_set(&probe_rx, 1);

		enum wm_parse_result r = wm_parse_perception(buf, (size_t)n, &ev.frame);

		ev.t_arrival_cyc = t;
		if (r == WM_PARSE_OK) {
			ev.kind = EV_FRAME;
			k_spinlock_key_t key = k_spin_lock(&peer_lock);

			peer = src;
			peer.sin_port = htons(WM_PORT_STATUS);
			k_spin_unlock(&peer_lock, key);
		} else {
			ev.kind = EV_BAD;
			ev.bad = (uint8_t)r;
		}
		if (k_msgq_put(&ev_q, &ev, K_NO_WAIT) != 0) {
			k_spinlock_key_t key = k_spin_lock(&g_lock);

			g_meas.queue_overflow++;
			k_spin_unlock(&g_lock, key);
			pin_set(&probe_rx, 0);
		}
	}
}

static void status_tx_fn(void *a, void *b, void *c)
{
	ARG_UNUSED(a);
	ARG_UNUSED(b);
	ARG_UNUSED(c);

	int s = zsock_socket(AF_INET, SOCK_DGRAM, IPPROTO_UDP);

	if (s < 0) {
		LOG_ERR("status socket: %d", errno);
		return;
	}
	for (;;) {
		wm_status_t st;
		struct sockaddr_in dst;

		k_msgq_get(&status_q, &st, K_FOREVER);
		k_spinlock_key_t key = k_spin_lock(&peer_lock);

		dst = peer;
		k_spin_unlock(&peer_lock, key);

		if (zsock_sendto(s, &st, sizeof(st), 0, (struct sockaddr *)&dst, sizeof(dst)) < 0) {
			key = k_spin_lock(&g_lock);
			g_meas.status_tx_fail++;
			k_spin_unlock(&g_lock, key);
		}
	}
}

/* ---------------------------------------------------------------- black box */

static struct wm_bb_entry bb_ring[WM_BB_LEN];
static struct wm_bb_entry bb_frozen[WM_BB_LEN];
static uint32_t bb_head;
static bool bb_has_frozen;

/* caller holds g_lock */
static void blackbox_record(const struct wm_bb_entry *e)
{
	bb_ring[bb_head % WM_BB_LEN] = *e;
	bb_head++;
}

void wm_blackbox_freeze(void)
{
	k_spinlock_key_t key = k_spin_lock(&g_lock);

	for (uint32_t i = 0; i < WM_BB_LEN; i++) {
		bb_frozen[i] = bb_ring[(bb_head + i) % WM_BB_LEN]; /* oldest first */
	}
	bb_has_frozen = true;
	k_spin_unlock(&g_lock, key);
}

void wm_blackbox_print(void (*print)(void *ctx, const struct wm_bb_entry *e), void *ctx)
{
	if (!bb_has_frozen) {
		return;
	}
	for (uint32_t i = 0; i < WM_BB_LEN; i++) {
		if (bb_frozen[i].t_ms != 0) {
			print(ctx, &bb_frozen[i]);
		}
	}
}

/* ---------------------------------------------------------------- decide */

void wm_meas_reset(void)
{
	wm_hist_reset(&g_meas.latency);
	wm_run_reset(&g_meas.interval_us);
	wm_run_reset(&g_meas.failover_ms);
	g_meas.queue_overflow = 0;
	g_meas.status_tx_fail = 0;
}

static void queue_status(uint32_t seq, uint64_t tx_time_us, uint32_t latency_ns)
{
	wm_status_t st = {
		.magic = WM_MAGIC_STATUS,
		.version = WM_VERSION,
		.seq_echo = seq,
		.tx_time_us_echo = tx_time_us,
		.decision_latency_ns = latency_ns,
	};
	k_spinlock_key_t key = k_spin_lock(&g_lock);

	st.state = (uint8_t)g_sup.state;
	st.ttc_ms = g_sup.threat.ttc_ms;
	st.threat_id = g_sup.threat.id;
	st.fault_flags = wm_sup_take_faults(&g_sup);
	st.imu_ax_mg = g_imu.ax_mg;
	st.imu_ay_mg = g_imu.ay_mg;
	st.maneuver = g_imu.maneuver;
	k_spin_unlock(&g_lock, key);

	st.crc16 = wm_crc16(&st, WM_STATUS_CRC_LEN);
	k_msgq_put(&status_q, &st, K_NO_WAIT); /* drop if the sender is behind */
}

static void log_transition(enum wm_state from, enum wm_state to, const struct wm_threat *t)
{
	if (t->id != WM_THREAT_NONE) {
		LOG_INF("[%u] %s -> %s id=%u ttc=%dms dist=%d.%dm", k_uptime_get_32(),
			wm_state_name(from), wm_state_name(to), t->id, t->ttc_ms,
			t->dist_mm / 1000, (t->dist_mm % 1000) / 100);
	} else {
		LOG_INF("[%u] %s -> %s", k_uptime_get_32(), wm_state_name(from), wm_state_name(to));
	}
}

static void decide_fn(void *a, void *b, void *c)
{
	ARG_UNUSED(a);
	ARG_UNUSED(b);
	ARG_UNUSED(c);

	static struct wm_event ev;
	uint32_t last_accept_cyc = 0;
	bool have_last_accept = false;
	uint32_t last_seq = 0;
	uint64_t last_tx_time = 0;
	int64_t last_keepalive = 0;

	watchdog_start();

	for (;;) {
		watchdog_feed();

		if (g_hang_requested) {
			printk("wm: decide thread stalled on purpose; watchdog reset in <= %d ms\n",
			       WM_WDT_TIMEOUT_MS);
			for (;;) {
				k_busy_wait(1000);
			}
		}

		if (k_msgq_get(&ev_q, &ev, K_MSEC(WM_DECIDE_POLL_MS)) != 0) {
			/* Idle: while failed safe, keep telling the TX2 so it can show it. */
			if (g_sup.state == WM_FAILSAFE &&
			    k_uptime_get() - last_keepalive >= WM_KEEPALIVE_MS) {
				last_keepalive = k_uptime_get();
				queue_status(last_seq, last_tx_time, 0);
			}
			continue;
		}

		k_spinlock_key_t key = k_spin_lock(&g_lock);
		enum wm_state before = g_sup.state;
		bool accepted = false;

		switch (ev.kind) {
		case EV_FRAME:
			accepted = wm_sup_on_frame(&g_sup, &ev.frame);
			break;
		case EV_BAD:
			wm_sup_on_bad(&g_sup, (enum wm_parse_result)ev.bad);
			break;
		case EV_HB_LOST:
			wm_sup_on_heartbeat_lost(&g_sup);
			break;
		}
		enum wm_state after = g_sup.state;
		struct wm_threat threat = g_sup.threat;

		k_spin_unlock(&g_lock, key);

		bool changed = before != after;

		if (ev.kind == EV_FRAME && accepted) {
			outputs_apply(after, changed);
			uint32_t t_out = k_cycle_get_32();

			pin_set(&probe_rx, 0);

			uint32_t lat_ns = (uint32_t)k_cyc_to_ns_floor64(t_out - ev.t_arrival_cyc);

			/* Heartbeat restarts from this frame. */
			atomic_set(&last_valid_ms, (atomic_val_t)k_uptime_get_32());
			atomic_set(&hb_armed, 1);

			key = k_spin_lock(&g_lock);
			wm_hist_add(&g_meas.latency, lat_ns);
			if (have_last_accept) {
				wm_run_add(&g_meas.interval_us,
					   k_cyc_to_ns_floor64(ev.t_arrival_cyc - last_accept_cyc) /
						   1000.0);
			}
			struct wm_bb_entry e = {
				.t_ms = k_uptime_get_32(),
				.state = (uint8_t)after,
				.threat_id = threat.id,
				.ttc_ms = threat.ttc_ms,
				.ax_mg = g_imu.ax_mg,
				.ay_mg = g_imu.ay_mg,
			};
			blackbox_record(&e);
			k_spin_unlock(&g_lock, key);

			last_accept_cyc = ev.t_arrival_cyc;
			have_last_accept = true;
			last_seq = ev.frame.seq;
			last_tx_time = ev.frame.tx_time_us;
			queue_status(last_seq, last_tx_time, lat_ns);
		} else {
			pin_set(&probe_rx, 0);
			if (changed) {
				outputs_apply(after, true);
			}
			if (ev.kind == EV_HB_LOST && changed && have_last_accept) {
				uint32_t t_out = k_cycle_get_32();

				key = k_spin_lock(&g_lock);
				wm_run_add(&g_meas.failover_ms,
					   k_cyc_to_ns_floor64(t_out - last_accept_cyc) / 1e6);
				k_spin_unlock(&g_lock, key);
			}
			if (ev.kind == EV_HB_LOST) {
				/* Intervals across an outage aren't jitter; and k_cycle wraps in ~4.3 s. */
				have_last_accept = false;
			}
			if (ev.kind != EV_FRAME) {
				last_keepalive = k_uptime_get();
				queue_status(last_seq, last_tx_time, 0);
			}
		}

		if (changed) {
			log_transition(before, after, &threat);
		}
	}
}

/* ---------------------------------------------------------------- main */

K_THREAD_STACK_DEFINE(decide_stack, 4096);
K_THREAD_STACK_DEFINE(net_rx_stack, 4096);
K_THREAD_STACK_DEFINE(status_tx_stack, 2048);
static struct k_thread decide_thread, net_rx_thread, status_tx_thread;

int main(void)
{
	LOG_INF("Wingman safety supervisor, %u Hz cycle counter", sys_clock_hw_cycles_per_sec());

	wm_sup_init(&g_sup, NULL);
	wm_meas_reset();
	if (last_reset_was_watchdog()) {
		g_sup.sticky_faults |= WM_FAULT_WDT_RESET;
		LOG_WRN("last reset was caused by the WATCHDOG");
	}

	peer.sin_family = AF_INET;
	peer.sin_port = htons(WM_PORT_STATUS);
	zsock_inet_pton(AF_INET, WM_DEFAULT_PEER_IP, &peer.sin_addr);

	outputs_init();
	k_timer_start(&led_timer, K_MSEC(62), K_MSEC(62));

	k_thread_create(&decide_thread, decide_stack, K_THREAD_STACK_SIZEOF(decide_stack),
			decide_fn, NULL, NULL, NULL, PRIO_DECIDE, 0, K_NO_WAIT);
	k_thread_name_set(&decide_thread, "decide");
	k_thread_create(&status_tx_thread, status_tx_stack, K_THREAD_STACK_SIZEOF(status_tx_stack),
			status_tx_fn, NULL, NULL, NULL, PRIO_STATUS_TX, 0, K_NO_WAIT);
	k_thread_name_set(&status_tx_thread, "status_tx");
	k_thread_create(&net_rx_thread, net_rx_stack, K_THREAD_STACK_SIZEOF(net_rx_stack),
			net_rx_fn, NULL, NULL, NULL, PRIO_NET_RX, 0, K_NO_WAIT);
	k_thread_name_set(&net_rx_thread, "net_rx");

	k_spinlock_key_t key = k_spin_lock(&g_lock);

	wm_sup_link_ready(&g_sup);
	k_spin_unlock(&g_lock, key);
	atomic_set(&led_state, WM_WAIT_LINK);
	LOG_INF("state BOOT -> WAIT_LINK, waiting for perception on udp :%d", WM_PORT_PERCEPTION);

	k_timer_start(&hb_timer, K_MSEC(10), K_MSEC(10));
	return 0;
}
```

## src/imu.c
```c
/*
 * Onboard ICM-40627 -> driver context for the supervisor.
 *
 * 100 Hz, bias removed at boot (board must be still for ~0.5 s), low-passed.
 *   braking  : longitudinal < -300 mg for 200 ms  -> WARNING downgraded to CAUTION
 *   swerve   : |lateral| > 300 mg for 100 ms during CAUTION/WARNING -> near-miss log
 *   impact   : |horizontal| > 2 g on one raw sample -> latch + freeze the black box
 *
 * Axis mapping assumes board +X = vehicle forward, +Y = right. Change AX_/AY_
 * below if the board is mounted differently.
 */
#include <math.h>

#include <zephyr/drivers/sensor.h>
#include <zephyr/kernel.h>
#include <zephyr/logging/log.h>

#include "wm_app.h"

LOG_MODULE_REGISTER(wm_imu, LOG_LEVEL_INF);

#define AX_IDX  0
#define AX_SIGN 1
#define AY_IDX  1
#define AY_SIGN 1

#define IMU_PERIOD_MS    10
#define ZERO_SAMPLES     50
#define LPF_ALPHA        0.2
#define BRAKE_MG         (-300)
#define ACCEL_MG         200
#define SWERVE_MG        300
#define IMPACT_MG        2000.0
#define BRAKE_SAMPLES    20 /* 200 ms */
#define ACCEL_SAMPLES    20
#define SWERVE_SAMPLES   10 /* 100 ms */

static const struct device *const imu = DEVICE_DT_GET_OR_NULL(DT_ALIAS(accel0));

struct wm_imu_state g_imu;

static volatile bool rezero_requested = true;

void wm_imu_rezero(void)
{
	rezero_requested = true;
}

static void imu_fn(void *a, void *b, void *c)
{
	ARG_UNUSED(a);
	ARG_UNUSED(b);
	ARG_UNUSED(c);

	if (!imu || !device_is_ready(imu)) {
		LOG_WRN("IMU not ready; running without driver context");
		return;
	}

	double bias[3] = {0}, acc[3] = {0};
	int n_zero = 0;
	double fx = 0, fy = 0;
	int brake_n = 0, accel_n = 0, swerve_n = 0;
	bool near_miss_logged = false;

	for (;;) {
		k_sleep(K_MSEC(IMU_PERIOD_MS));

		struct sensor_value v[3];

		if (sensor_sample_fetch(imu) != 0 ||
		    sensor_channel_get(imu, SENSOR_CHAN_ACCEL_XYZ, v) != 0) {
			continue;
		}
		double mg[3];

		for (int i = 0; i < 3; i++) {
			mg[i] = sensor_value_to_double(&v[i]) * 1000.0 / SENSOR_G * 1000000.0;
		}

		if (rezero_requested) {
			rezero_requested = false;
			n_zero = 0;
			acc[0] = acc[1] = acc[2] = 0;
		}
		if (n_zero < ZERO_SAMPLES) {
			for (int i = 0; i < 3; i++) {
				acc[i] += mg[i];
			}
			if (++n_zero == ZERO_SAMPLES) {
				for (int i = 0; i < 3; i++) {
					bias[i] = acc[i] / ZERO_SAMPLES;
				}
				fx = fy = 0;
				LOG_INF("IMU zeroed: bias %d %d %d mg", (int)bias[0], (int)bias[1],
					(int)bias[2]);
			}
			continue;
		}

		double x = AX_SIGN * (mg[AX_IDX] - bias[AX_IDX]);
		double y = AY_SIGN * (mg[AY_IDX] - bias[AY_IDX]);

		fx += LPF_ALPHA * (x - fx);
		fy += LPF_ALPHA * (y - fy);

		brake_n = fx < BRAKE_MG ? brake_n + 1 : 0;
		accel_n = fx > ACCEL_MG ? accel_n + 1 : 0;
		swerve_n = fabs(fy) > SWERVE_MG ? swerve_n + 1 : 0;

		bool braking = brake_n >= BRAKE_SAMPLES;
		bool swerving = swerve_n >= SWERVE_SAMPLES;
		uint8_t man = WM_MAN_STEADY;

		if (swerving) {
			man = WM_MAN_SWERVE;
		} else if (braking) {
			man = WM_MAN_BRAKE;
		} else if (accel_n >= ACCEL_SAMPLES) {
			man = WM_MAN_ACCEL;
		}

		bool impact = sqrt(x * x + y * y) > IMPACT_MG;

		k_spinlock_key_t key = k_spin_lock(&g_lock);
		bool first_impact = impact && !g_imu.impact_latched;
		enum wm_state st = g_sup.state;
		uint16_t threat_id = g_sup.threat.id;

		g_imu.ok = true;
		g_imu.ax_mg = (int16_t)CLAMP(fx, INT16_MIN, INT16_MAX);
		g_imu.ay_mg = (int16_t)CLAMP(fy, INT16_MIN, INT16_MAX);
		g_imu.maneuver = man;
		if (impact) {
			g_imu.impact_latched = true;
		}
		wm_sup_set_braking(&g_sup, braking);
		k_spin_unlock(&g_lock, key);

		if (first_impact) {
			wm_blackbox_freeze();
			LOG_WRN("IMPACT %d mg: black box frozen (wm blackbox)", (int)sqrt(x * x + y * y));
		}
		if (swerving && (st == WM_CAUTION || st == WM_WARNING)) {
			if (!near_miss_logged) {
				near_miss_logged = true;
				LOG_WRN("NEAR-MISS: swerve %d mg during %s, threat id=%u", (int)fy,
					wm_state_name(st), threat_id);
			}
		} else if (!swerving) {
			near_miss_logged = false;
		}
	}
}

K_THREAD_DEFINE(imu_tid, 2048, imu_fn, NULL, NULL, NULL, 6, 0, 500);
```

## src/shell.c
```c
/*
 * wm stats [reset]          latency histogram, jitter, failover, counters
 * wm state                  current state, threat, faults, thresholds
 * wm reset                  clear counters/faults, back to WAIT_LINK
 * wm thresh <caution> <warn>  TTC enter thresholds in ms (exit = enter + 300)
 * wm imu [zero]             IMU context; "zero" re-measures bias (keep board still)
 * wm blackbox               decisions frozen at the last impact
 * wm hang                   stall the decide thread -> watchdog reset
 */
#include <stdlib.h>

#include <zephyr/kernel.h>
#include <zephyr/shell/shell.h>

#include "wm_app.h"

/* Print doubles without relying on printf float support. */
#define FX2(v)      (int)(v), (int)(((v) < 0 ? -(v) : (v)) * 100) % 100
#define US(ns)      (ns) / 1000u, ((ns) % 1000u) / 10u

static int cmd_stats(const struct shell *sh, size_t argc, char **argv)
{
	static struct wm_measurements m;
	struct wm_counters c;

	if (argc > 1 && strcmp(argv[1], "reset") == 0) {
		k_spinlock_key_t key = k_spin_lock(&g_lock);

		wm_meas_reset();
		k_spin_unlock(&g_lock, key);
		shell_print(sh, "stats cleared");
		return 0;
	}

	k_spinlock_key_t key = k_spin_lock(&g_lock);

	m = g_meas;
	c = g_sup.cnt;
	k_spin_unlock(&g_lock, key);

	const struct wm_hist *h = &m.latency;

	shell_print(sh, "decision latency (socket delivery -> outputs written), n=%u", h->n);
	if (h->n) {
		uint32_t p50 = wm_hist_percentile_ns(h, 500);
		uint32_t p99 = wm_hist_percentile_ns(h, 990);
		uint32_t mean = wm_hist_mean_ns(h);

		shell_print(sh, "  min %u.%02u us  mean %u.%02u us  p50<=%u.%02u us  p99<=%u.%02u us  max %u.%02u us",
			    US(h->min_ns), US(mean), US(p50), US(p99), US(h->max_ns));
		shell_print(sh, "  histogram (%u ns buckets, non-empty only):", WM_HIST_BUCKET_NS);
		for (uint32_t b = 0; b <= WM_HIST_BUCKETS; b++) {
			if (!h->bucket[b]) {
				continue;
			}
			if (b == WM_HIST_BUCKETS) {
				shell_print(sh, "    >=%u.%02u us : %u", US(b * WM_HIST_BUCKET_NS),
					    h->bucket[b]);
			} else {
				shell_print(sh, "    %u.%02u-%u.%02u us : %u", US(b * WM_HIST_BUCKET_NS),
					    US((b + 1) * WM_HIST_BUCKET_NS), h->bucket[b]);
			}
		}
	}
	shell_print(sh, "inter-decision interval, n=%u: mean %d.%02d us  std %d.%02d us  min %d.%02d  max %d.%02d",
		    m.interval_us.n, FX2(m.interval_us.mean), FX2(wm_run_std(&m.interval_us)),
		    FX2(m.interval_us.min), FX2(m.interval_us.max));
	shell_print(sh, "failover (last valid frame -> FAILSAFE outputs), n=%u: mean %d.%02d ms  min %d.%02d  max %d.%02d",
		    m.failover_ms.n, FX2(m.failover_ms.mean), FX2(m.failover_ms.min),
		    FX2(m.failover_ms.max));
	shell_print(sh, "frames ok %u  crc %u  bad_len %u  seq_gap %u  seq_old %u", c.frames_ok,
		    c.crc_fail, c.bad_len, c.seq_gap, c.seq_old);
	shell_print(sh, "heartbeat_loss %u  failsafe_entries %u  braking_suppressed %u",
		    c.heartbeat_loss, c.failsafe_entries, c.braking_suppressed);
	shell_print(sh, "queue_overflow %u  status_tx_fail %u", m.queue_overflow, m.status_tx_fail);
	return 0;
}

static int cmd_state(const struct shell *sh, size_t argc, char **argv)
{
	ARG_UNUSED(argc);
	ARG_UNUSED(argv);

	k_spinlock_key_t key = k_spin_lock(&g_lock);
	struct wm_sup s = g_sup;

	k_spin_unlock(&g_lock, key);

	shell_print(sh, "state %s", wm_state_name(s.state));
	if (s.threat.id != WM_THREAT_NONE) {
		shell_print(sh, "threat id=%u ttc=%d ms dist=%d mm%s", s.threat.id, s.threat.ttc_ms,
			    s.threat.dist_mm, s.threat.close_range ? " CLOSE-RANGE" : "");
	} else {
		shell_print(sh, "threat none");
	}
	uint16_t f = s.faults | s.sticky_faults | (s.hb_lost ? WM_FAULT_HEARTBEAT : 0);

	shell_print(sh, "faults 0x%02x%s%s%s%s%s%s", f, (f & WM_FAULT_HEARTBEAT) ? " HEARTBEAT" : "",
		    (f & WM_FAULT_CRC) ? " CRC" : "", (f & WM_FAULT_SEQ_GAP) ? " SEQ_GAP" : "",
		    (f & WM_FAULT_SEQ_OLD) ? " SEQ_OLD" : "", (f & WM_FAULT_BAD_LEN) ? " BAD_LEN" : "",
		    (f & WM_FAULT_WDT_RESET) ? " WDT_RESET" : "");
	shell_print(sh, "driver braking %s, last seq %u", s.driver_braking ? "yes" : "no", s.last_seq);
	shell_print(sh, "thresholds: caution %d/%d ms  warn %d/%d ms (enter/exit)  close %d mm  lane %d mm  heartbeat %u ms",
		    s.th.caution_enter_ms, s.th.caution_exit_ms, s.th.warn_enter_ms,
		    s.th.warn_exit_ms, s.th.close_range_mm, s.th.inpath_lat_mm,
		    s.th.heartbeat_timeout_ms);
	return 0;
}

static int cmd_reset(const struct shell *sh, size_t argc, char **argv)
{
	ARG_UNUSED(argc);
	ARG_UNUSED(argv);

	k_spinlock_key_t key = k_spin_lock(&g_lock);

	wm_sup_reset(&g_sup);
	wm_meas_reset();
	g_imu.impact_latched = false;
	k_spin_unlock(&g_lock, key);
	shell_print(sh, "supervisor reset -> WAIT_LINK");
	return 0;
}

static int cmd_thresh(const struct shell *sh, size_t argc, char **argv)
{
	int caution = atoi(argv[1]);
	int warn = atoi(argv[2]);

	if (warn <= 0 || caution <= warn) {
		shell_error(sh, "need 0 < warn < caution (ms)");
		return -EINVAL;
	}
	k_spinlock_key_t key = k_spin_lock(&g_lock);

	g_sup.th.caution_enter_ms = caution;
	g_sup.th.caution_exit_ms = caution + 300;
	g_sup.th.warn_enter_ms = warn;
	g_sup.th.warn_exit_ms = warn + 300;
	k_spin_unlock(&g_lock, key);
	shell_print(sh, "caution %d/%d ms, warn %d/%d ms", caution, caution + 300, warn, warn + 300);
	return 0;
}

static int cmd_imu(const struct shell *sh, size_t argc, char **argv)
{
	static const char *const names[] = {"unknown", "steady", "brake", "accel", "swerve"};

	if (argc > 1 && strcmp(argv[1], "zero") == 0) {
		wm_imu_rezero();
		shell_print(sh, "re-zeroing IMU, keep the board still for 0.5 s");
		return 0;
	}
	k_spinlock_key_t key = k_spin_lock(&g_lock);
	struct wm_imu_state s = g_imu;
	bool braking = g_sup.driver_braking;

	k_spin_unlock(&g_lock, key);

	if (!s.ok) {
		shell_print(sh, "IMU not running");
		return 0;
	}
	shell_print(sh, "ax %d mg  ay %d mg  maneuver %s  braking %s  impact %s", s.ax_mg, s.ay_mg,
		    s.maneuver < ARRAY_SIZE(names) ? names[s.maneuver] : "?", braking ? "yes" : "no",
		    s.impact_latched ? "LATCHED" : "no");
	return 0;
}

static void bb_print(void *ctx, const struct wm_bb_entry *e)
{
	const struct shell *sh = ctx;

	shell_print(sh, "  %8u ms  %-9s id=%-5u ttc=%-6d ax=%-5d ay=%d", e->t_ms,
		    wm_state_name((enum wm_state)e->state), e->threat_id, e->ttc_ms, e->ax_mg,
		    e->ay_mg);
}

static int cmd_blackbox(const struct shell *sh, size_t argc, char **argv)
{
	ARG_UNUSED(argc);
	ARG_UNUSED(argv);

	shell_print(sh, "black box (last %d decisions before impact, oldest first):", WM_BB_LEN);
	wm_blackbox_print(bb_print, (void *)sh);
	return 0;
}

static int cmd_hang(const struct shell *sh, size_t argc, char **argv)
{
	ARG_UNUSED(argc);
	ARG_UNUSED(argv);

	shell_warn(sh, "stalling decide thread...");
	g_hang_requested = true;
	return 0;
}

SHELL_STATIC_SUBCMD_SET_CREATE(wm_cmds,
	SHELL_CMD_ARG(stats, NULL, "Measurements. 'wm stats reset' clears them.", cmd_stats, 1, 1),
	SHELL_CMD(state, NULL, "State, threat, faults, thresholds.", cmd_state),
	SHELL_CMD(reset, NULL, "Clear counters and faults, back to WAIT_LINK.", cmd_reset),
	SHELL_CMD_ARG(thresh, NULL, "<caution_ms> <warn_ms> TTC enter thresholds.", cmd_thresh, 3, 0),
	SHELL_CMD_ARG(imu, NULL, "IMU context. 'wm imu zero' re-zeroes.", cmd_imu, 1, 1),
	SHELL_CMD(blackbox, NULL, "Decisions frozen at the last impact.", cmd_blackbox),
	SHELL_CMD(hang, NULL, "Stall the decide thread (watchdog demo).", cmd_hang),
	SHELL_SUBCMD_SET_END);

SHELL_CMD_REGISTER(wm, &wm_cmds, "Wingman supervisor", NULL);
```

## src/wm_app.h
```c
/* Shared state between main.c (threads), shell.c and imu.c. */
#ifndef WM_APP_H
#define WM_APP_H

#include <zephyr/kernel.h>

#include "wm_logic.h"
#include "wm_stats.h"

struct wm_measurements {
	struct wm_hist latency;      /* packet arrival -> outputs written */
	struct wm_run interval_us;   /* inter-decision interval */
	struct wm_run failover_ms;   /* last valid packet -> FAILSAFE outputs written */
	uint32_t queue_overflow;     /* events dropped because decide was behind */
	uint32_t status_tx_fail;
};

struct wm_imu_state {
	bool ok;
	int16_t ax_mg; /* longitudinal, +forward, low-passed, bias-removed */
	int16_t ay_mg; /* lateral, +right */
	uint8_t maneuver;
	bool impact_latched;
};

/* Guards g_sup, g_meas and g_imu. Held for microseconds only. */
extern struct k_spinlock g_lock;
extern struct wm_sup g_sup;
extern struct wm_measurements g_meas;
extern struct wm_imu_state g_imu;

extern volatile bool g_hang_requested;

void wm_meas_reset(void);

/* Black box: last ~2 s of decisions, frozen on impact. */
struct wm_bb_entry {
	uint32_t t_ms;
	uint8_t state;
	uint16_t threat_id;
	int32_t ttc_ms;
	int16_t ax_mg;
	int16_t ay_mg;
};
#define WM_BB_LEN 64
void wm_blackbox_freeze(void);
void wm_blackbox_print(void (*print)(void *ctx, const struct wm_bb_entry *e), void *ctx);

void wm_imu_rezero(void);

#endif /* WM_APP_H */
```

## src/wm_logic.c
```c
#include <string.h>

#include "wm_logic.h"

void wm_thresholds_default(struct wm_thresholds *th)
{
	th->caution_enter_ms = 2500;
	th->caution_exit_ms = 2800;
	th->warn_enter_ms = 1200;
	th->warn_exit_ms = 1500;
	th->close_range_mm = 3000;
	th->inpath_lat_mm = 1500;
	th->closing_deadband_mm_s = 100;
	th->min_conf = 102; /* 0.4 * 255 */
	th->heartbeat_timeout_ms = 100;
	th->bad_frames_to_failsafe = 5;
	th->good_frames_to_recover = 10;
}

enum wm_parse_result wm_parse_perception(const void *buf, size_t len, wm_perception_t *out)
{
	if (len != sizeof(wm_perception_t)) {
		return WM_PARSE_BAD_LEN;
	}
	memcpy(out, buf, sizeof(*out));
	if (wm_crc16(out, WM_PERCEPTION_CRC_LEN) != out->crc16) {
		return WM_PARSE_BAD_CRC;
	}
	if (out->magic != WM_MAGIC_PERCEPTION || out->version != WM_VERSION ||
	    out->n_tracks > WM_MAX_TRACKS) {
		return WM_PARSE_BAD_FORMAT;
	}
	return WM_PARSE_OK;
}

static int32_t abs32(int32_t v)
{
	return v < 0 ? -v : v;
}

void wm_find_threat(const struct wm_thresholds *th, const wm_perception_t *f,
		    struct wm_threat *out)
{
	out->ttc_ms = WM_TTC_NONE;
	out->id = WM_THREAT_NONE;
	out->dist_mm = 0;
	out->close_range = false;

	for (unsigned int i = 0; i < f->n_tracks && i < WM_MAX_TRACKS; i++) {
		const wm_track_t *t = &f->tracks[i];

		if (t->conf < th->min_conf || t->dist_mm <= 0 || abs32(t->lat_mm) >= th->inpath_lat_mm ||
		    t->closing_mm_s <= th->closing_deadband_mm_s) {
			continue;
		}

		int64_t ttc = (int64_t)t->dist_mm * 1000 / t->closing_mm_s;

		if (ttc > INT32_MAX) {
			ttc = INT32_MAX;
		}
		if (t->dist_mm < th->close_range_mm) {
			out->close_range = true;
		}
		if (out->ttc_ms == WM_TTC_NONE || ttc < out->ttc_ms) {
			out->ttc_ms = (int32_t)ttc;
			out->id = t->id;
			out->dist_mm = t->dist_mm;
		}
	}
}

static void clear_threat(struct wm_threat *t)
{
	t->ttc_ms = WM_TTC_NONE;
	t->id = WM_THREAT_NONE;
	t->dist_mm = 0;
	t->close_range = false;
}

void wm_sup_init(struct wm_sup *s, const struct wm_thresholds *th)
{
	memset(s, 0, sizeof(*s));
	if (th) {
		s->th = *th;
	} else {
		wm_thresholds_default(&s->th);
	}
	s->state = WM_BOOT;
	clear_threat(&s->threat);
}

void wm_sup_reset(struct wm_sup *s)
{
	struct wm_thresholds th = s->th;
	bool braking = s->driver_braking;

	wm_sup_init(s, &th);
	s->driver_braking = braking;
	s->state = WM_WAIT_LINK;
}

void wm_sup_link_ready(struct wm_sup *s)
{
	if (s->state == WM_BOOT) {
		s->state = WM_WAIT_LINK;
	}
}

static void enter_failsafe(struct wm_sup *s)
{
	if (s->state != WM_FAILSAFE) {
		s->cnt.failsafe_entries++;
		s->state = WM_FAILSAFE;
	}
	s->consec_good = 0;
	clear_threat(&s->threat);
}

/* Hysteresis: thresholds to stay in a level are looser than to enter it. */
static enum wm_state evaluate(struct wm_sup *s, enum wm_state cur)
{
	const struct wm_thresholds *th = &s->th;
	const struct wm_threat *t = &s->threat;

	if (t->ttc_ms == WM_TTC_NONE) {
		return WM_NOMINAL;
	}

	bool warn = t->close_range ||
		    t->ttc_ms < (cur == WM_WARNING ? th->warn_exit_ms : th->warn_enter_ms);

	if (warn) {
		/* Driver already braking: don't nag, but never suppress the close-range override. */
		if (s->driver_braking && !t->close_range) {
			s->cnt.braking_suppressed++;
			return WM_CAUTION;
		}
		return WM_WARNING;
	}

	bool in_caution = (cur == WM_CAUTION || cur == WM_WARNING);

	if (t->ttc_ms < (in_caution ? th->caution_exit_ms : th->caution_enter_ms)) {
		return WM_CAUTION;
	}
	return WM_NOMINAL;
}

bool wm_sup_on_frame(struct wm_sup *s, const wm_perception_t *f)
{
	bool in_seq = true;

	if (s->have_seq) {
		int32_t d = (int32_t)(f->seq - s->last_seq);

		if (d <= 0) {
			s->cnt.seq_old++;
			s->faults |= WM_FAULT_SEQ_OLD;
			s->consec_good = 0;
			return false;
		}
		if (d != 1) {
			in_seq = false;
			s->cnt.seq_gap++;
			s->faults |= WM_FAULT_SEQ_GAP;
		}
	}
	s->have_seq = true;
	s->last_seq = f->seq;
	s->consec_bad = 0;
	s->hb_lost = false;
	s->cnt.frames_ok++;
	s->consec_good = in_seq ? s->consec_good + 1 : 0;

	wm_find_threat(&s->th, f, &s->threat);

	enum wm_state cur = s->state;

	if (cur == WM_FAILSAFE) {
		if (s->consec_good < s->th.good_frames_to_recover) {
			return true;
		}
		cur = WM_NOMINAL;
	} else if (cur == WM_BOOT || cur == WM_WAIT_LINK) {
		cur = WM_NOMINAL;
	}
	s->state = evaluate(s, cur);
	return true;
}

void wm_sup_on_bad(struct wm_sup *s, enum wm_parse_result why)
{
	if (why == WM_PARSE_BAD_CRC) {
		s->cnt.crc_fail++;
		s->faults |= WM_FAULT_CRC;
	} else {
		s->cnt.bad_len++;
		s->faults |= WM_FAULT_BAD_LEN;
	}
	s->consec_good = 0;
	s->consec_bad++;
	if (s->consec_bad >= s->th.bad_frames_to_failsafe) {
		enter_failsafe(s);
	}
}

void wm_sup_on_heartbeat_lost(struct wm_sup *s)
{
	if (s->state == WM_BOOT || s->state == WM_WAIT_LINK) {
		return; /* never had a link; nothing to lose */
	}
	if (!s->hb_lost) {
		s->cnt.heartbeat_loss++;
	}
	s->hb_lost = true;
	/* A restarted sender begins again at seq 0; accept it instead of flagging it old. */
	s->have_seq = false;
	enter_failsafe(s);
}

void wm_sup_set_braking(struct wm_sup *s, bool braking)
{
	s->driver_braking = braking;
}

uint16_t wm_sup_take_faults(struct wm_sup *s)
{
	uint16_t f = s->faults | s->sticky_faults;

	if (s->hb_lost) {
		f |= WM_FAULT_HEARTBEAT;
	}
	s->faults = 0;
	return f;
}

const char *wm_state_name(enum wm_state st)
{
	switch (st) {
	case WM_BOOT:
		return "BOOT";
	case WM_WAIT_LINK:
		return "WAIT_LINK";
	case WM_NOMINAL:
		return "NOMINAL";
	case WM_CAUTION:
		return "CAUTION";
	case WM_WARNING:
		return "WARNING";
	case WM_FAILSAFE:
		return "FAILSAFE";
	}
	return "?";
}
```

## src/wm_logic.h
```c
/*
 * Wingman supervisor core: frame parsing, threat selection, state machine.
 *
 * Pure C, no Zephyr dependencies, so it is unit-tested on the host
 * (rt1170/tests/host). The Zephyr glue in main.c owns one struct wm_sup and
 * calls it from the decide thread only.
 */
#ifndef WM_LOGIC_H
#define WM_LOGIC_H

#include <stdbool.h>
#include <stddef.h>
#include <stdint.h>

#include "wingman_proto.h"

struct wm_thresholds {
	int32_t caution_enter_ms;
	int32_t caution_exit_ms;
	int32_t warn_enter_ms;
	int32_t warn_exit_ms;
	int32_t close_range_mm;        /* in-path + closing + nearer than this -> WARNING */
	int32_t inpath_lat_mm;         /* |lat| below this is in our path */
	int32_t closing_deadband_mm_s; /* closing speed must exceed this to be a threat */
	uint8_t min_conf;              /* 0..255 */
	uint32_t heartbeat_timeout_ms;
	uint32_t bad_frames_to_failsafe;
	uint32_t good_frames_to_recover;
};

void wm_thresholds_default(struct wm_thresholds *th);

enum wm_parse_result {
	WM_PARSE_OK = 0,
	WM_PARSE_BAD_LEN,
	WM_PARSE_BAD_CRC,
	WM_PARSE_BAD_FORMAT, /* magic / version / n_tracks; reported as WM_FAULT_BAD_LEN */
};

/* Validates length, CRC, magic, version, n_tracks and copies into *out. */
enum wm_parse_result wm_parse_perception(const void *buf, size_t len, wm_perception_t *out);

struct wm_threat {
	int32_t ttc_ms;   /* WM_TTC_NONE if no threat */
	uint16_t id;      /* WM_THREAT_NONE if no threat */
	int32_t dist_mm;  /* distance of the min-TTC track */
	bool close_range; /* some in-path closing track is within close_range_mm */
};

void wm_find_threat(const struct wm_thresholds *th, const wm_perception_t *f,
		    struct wm_threat *out);

struct wm_counters {
	uint32_t frames_ok;
	uint32_t crc_fail;
	uint32_t bad_len;
	uint32_t seq_gap;
	uint32_t seq_old;
	uint32_t heartbeat_loss;
	uint32_t failsafe_entries;
	uint32_t braking_suppressed; /* frames where WARNING was downgraded to CAUTION */
};

struct wm_sup {
	struct wm_thresholds th;
	enum wm_state state;

	bool have_seq;
	uint32_t last_seq;
	uint32_t consec_bad;
	uint32_t consec_good;
	bool hb_lost;
	bool driver_braking;

	uint16_t faults;        /* transient, accumulated until wm_sup_take_faults() */
	uint16_t sticky_faults; /* e.g. WM_FAULT_WDT_RESET, cleared by wm_sup_reset() */

	struct wm_threat threat;
	struct wm_counters cnt;
};

/* th == NULL -> defaults. State starts at WM_BOOT. */
void wm_sup_init(struct wm_sup *s, const struct wm_thresholds *th);

/* Clears counters, faults (incl. sticky) and sequence tracking; back to WAIT_LINK. Keeps thresholds. */
void wm_sup_reset(struct wm_sup *s);

/* Network is up: BOOT -> WAIT_LINK. */
void wm_sup_link_ready(struct wm_sup *s);

/* A parsed, CRC-valid frame. Returns false if it was discarded (duplicate / out of order). */
bool wm_sup_on_frame(struct wm_sup *s, const wm_perception_t *f);

/* A frame that failed wm_parse_perception(). */
void wm_sup_on_bad(struct wm_sup *s, enum wm_parse_result why);

/* No valid frame for heartbeat_timeout_ms. */
void wm_sup_on_heartbeat_lost(struct wm_sup *s);

/* IMU context: driver already braking hard -> WARNING is downgraded to CAUTION. */
void wm_sup_set_braking(struct wm_sup *s, bool braking);

/* Current fault word for a status packet; clears the transient bits. */
uint16_t wm_sup_take_faults(struct wm_sup *s);

const char *wm_state_name(enum wm_state st);

#endif /* WM_LOGIC_H */
```

## src/wm_stats.c
```c
#include <math.h>
#include <string.h>

#include "wm_stats.h"

void wm_hist_reset(struct wm_hist *h)
{
	memset(h, 0, sizeof(*h));
	h->min_ns = UINT32_MAX;
}

void wm_hist_add(struct wm_hist *h, uint32_t ns)
{
	uint32_t b = ns / WM_HIST_BUCKET_NS;

	if (b > WM_HIST_BUCKETS) {
		b = WM_HIST_BUCKETS;
	}
	h->bucket[b]++;
	h->n++;
	h->sum_ns += ns;
	if (ns < h->min_ns) {
		h->min_ns = ns;
	}
	if (ns > h->max_ns) {
		h->max_ns = ns;
	}
}

uint32_t wm_hist_mean_ns(const struct wm_hist *h)
{
	return h->n ? (uint32_t)(h->sum_ns / h->n) : 0;
}

uint32_t wm_hist_percentile_ns(const struct wm_hist *h, uint32_t per_mille)
{
	if (h->n == 0) {
		return 0;
	}
	/* smallest bucket whose cumulative count reaches ceil(n * p) */
	uint64_t target = ((uint64_t)h->n * per_mille + 999) / 1000;
	uint64_t acc = 0;

	if (target == 0) {
		target = 1;
	}
	for (uint32_t b = 0; b <= WM_HIST_BUCKETS; b++) {
		acc += h->bucket[b];
		if (acc >= target) {
			return b == WM_HIST_BUCKETS ? h->max_ns : (b + 1) * WM_HIST_BUCKET_NS;
		}
	}
	return h->max_ns;
}

void wm_run_reset(struct wm_run *r)
{
	memset(r, 0, sizeof(*r));
}

void wm_run_add(struct wm_run *r, double x)
{
	r->n++;
	if (r->n == 1 || x < r->min) {
		r->min = x;
	}
	if (r->n == 1 || x > r->max) {
		r->max = x;
	}
	double d = x - r->mean;

	r->mean += d / r->n;
	r->m2 += d * (x - r->mean);
}

double wm_run_std(const struct wm_run *r)
{
	return r->n > 1 ? sqrt(r->m2 / (r->n - 1)) : 0.0;
}
```

## src/wm_stats.h
```c
/*
 * Measurement accumulators. Pure C; host-tested.
 *
 * wm_hist: fixed-bucket latency histogram (WM_HIST_BUCKET_NS wide, last bucket
 *          collects overflow) with exact min/max/mean and bucket-resolution
 *          percentiles.
 * wm_run:  running min/max/mean/stddev (Welford) for intervals and failover times.
 */
#ifndef WM_STATS_H
#define WM_STATS_H

#include <stdint.h>

#define WM_HIST_BUCKET_NS 500u
#define WM_HIST_BUCKETS   400u /* 400 x 0.5 us = 200 us; bucket 400 = overflow */

struct wm_hist {
	uint32_t n;
	uint32_t min_ns;
	uint32_t max_ns;
	uint64_t sum_ns;
	uint32_t bucket[WM_HIST_BUCKETS + 1];
};

void wm_hist_reset(struct wm_hist *h);
void wm_hist_add(struct wm_hist *h, uint32_t ns);
uint32_t wm_hist_mean_ns(const struct wm_hist *h);
/* Upper edge (ns) of the bucket holding the given percentile (per_mille: 500 = p50, 990 = p99). */
uint32_t wm_hist_percentile_ns(const struct wm_hist *h, uint32_t per_mille);

struct wm_run {
	uint32_t n;
	double min;
	double max;
	double mean;
	double m2;
};

void wm_run_reset(struct wm_run *r);
void wm_run_add(struct wm_run *r, double x);
double wm_run_std(const struct wm_run *r);

#endif /* WM_STATS_H */
```
